## Firmware/main/Kconfig.projbuild
```kconfig
menu "Custom Configuration"

    menu "Sensor Configuration"
        config PRESSURE_SENSOR_ENABLE
            bool "Enable Pressure Sensor"
            default y
            help
                Enable or disable the pressure sensor.

        config TEMPERATURE_SENSOR_ENABLE
            bool "Enable Temperature Sensor"
            default y
            help
                Enable or disable the temperature sensor.

        config FLOW_SENSOR_ENABLE
            bool "Enable Flow Sensor"
            default y
            help
                Enable or disable the flow sensor.

        choice FLOW_SENSOR_PRODUCT
            prompt "Flow Sensor Product Model"
            depends on FLOW_SENSOR_ENABLE
            default FLOW_SENSOR_0600F
            help
                Select the SLF3S flow sensor model.

            config FLOW_SENSOR_0600F
                bool "SLF3S-0600F (±3250 µl/min)"
                help
                    Select SLF3S-0600F model with ±3250 µl/min output range.
                    Scale factor: 10

            config FLOW_SENSOR_1300F
                bool "SLF3S-1300F (0-40 ml/min)"
                help
                    Select SLF3S-1300F model with 0-40 ml/min range.
                    Scale factor: 500
        endchoice
    endmenu

    choice PUMP_DRIVER
        prompt "Pump Driver Type"
        default MP_DRIVER
        help
            Select the type of pump driver to use for the MP6 pump.

        config LOW_MP_DRIVER
            bool "Low MP-Driver"
            help
                Select this option to use the low MP-driver.

        config HIGH_MP_DRIVER
            bool "High MP-Driver"
            help
                Select this option to use the high MP-driver.

        config MP_DRIVER
            bool "MP-Driver"
            help
                Select this option to use the standard MP-driver.
    endchoice

    choice COMMUNICATION_TYPE
        prompt "Communication Method"
        default COMM_SERIAL
        help
            Select the communication method for data transmission.

        config COMM_SERIAL
            bool "Serial"
            help
                Use serial communication.

        config COMM_WIFI
            bool "WiFi"
            help
                Use WiFi communication.
    endchoice

    menu "Pin Configuration"
        config I2C_SDA_PIN
            int "I2C SDA Pin"
            default 21
            help
                Set the pin number for I2C SDA.

        config I2C_SCL_PIN
            int "I2C SCL Pin"
            default 22
            help
                Set the pin number for I2C SCL.

        config MP_DRIVER_ENABLE_PIN
            int "MP Driver Enable Pin"
            default 14
            help
                Set the pin number for MP driver enable signal.

        config MP_DRIVER_CLOCK_PIN
            int "MP Driver Clock Pin"
            default 27
            help
                Set the pin number for MP driver clock signal.
    endmenu


    menu "WiFi Configuration"
        depends on COMM_WIFI

        config WIFI_SSID
            string "WiFi SSID"
            default "admin_test"
            help
                Set the SSID of the WiFi network to connect to.

        config WIFI_PASS
            string "WiFi Password"
            default "123456789"
            help
                Set the password of the WiFi network to connect to.

        config SERVICE_ADDRESS
            string "Service Address"
            default "192.168.137.1"
            help
                Set the IP address for the server.

        config SERVICE_PORT
            int "Service Port"
            default 8999
            help
                Set the port number for the server.
    endmenu

endmenu
```
